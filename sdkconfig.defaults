## sdkconfig.defaults
```kconfig
# Modbus konfiguracija
CONFIG_FMB_COMM_MODE_TCP_EN=y
CONFIG_FMB_MASTER_TIMEOUT_MS_RESPOND=3000
CONFIG_FMB_MASTER_DELAY_MS_CONVERT=200
CONFIG_FMB_CONTROLLER_NOTIFY_TIMEOUT=20
CONFIG_FMB_CONTROLLER_NOTIFY_QUEUE_SIZE=20
CONFIG_FMB_PORT_TASK_PRIO=10
CONFIG_FMB_PORT_TASK_STACK_SIZE=4096
CONFIG_FMB_TIMER_PORT_ENABLED=y

# Logiranje
CONFIG_LOG_DEFAULT_LEVEL_INFO=y
```
